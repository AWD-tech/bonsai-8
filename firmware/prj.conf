## CMakeLists.txt
```
cmake_minimum_required(VERSION 3.20.0)
find_package(Zephyr REQUIRED HINTS $ENV{ZEPHYR_BASE})
project(bonsai-8)
include(${ZEPHYR_BASE}/samples/subsys/usb/common/common.cmake)
target_sources(app PRIVATE src/main.c src/sp1_emmc.c src/dual_engine.c src/dual_mirror.c src/dual_capture.c src/bonsai_record.c src/bonsai_library.c src/bonsai_playlist.c src/bonsai_cdc.c src/bonsai_sync.c src/bonsai_stretch.c)

# -fno-strict-aliasing: the firmware type-puns static uint8_t[] storage through
# int16_t* / struct* lvalues (the batchbuf copies and the meta-block cast). This
# removes the TBAA assumption so those puns stay correct under -O2 -- the same
# idiom the Linux kernel and Zephyr core build with. Purely subtractive; it can
# only remove an optimizer assumption, never miscompile correct code.
target_compile_options(app PRIVATE -fno-strict-aliasing)

# NOTE: -O2 on sp1_emmc.c was REVERTED. It sped up reads but BROKE the timing-
# sensitive flash WRITE bit-bang -- ~half of writes failed CRC and retried, which
# overflowed the record ring under record+play load (corruption/glitching). The
# eMMC driver stays at the global -Os, where the write timing is correct.

target_compile_definitions(app PRIVATE SP1_DUAL_DECK=1)
set_source_files_properties(src/dual_engine.c src/bonsai_record.c src/bonsai_stretch.c PROPERTIES COMPILE_OPTIONS "-O2")
```

## prj.conf
```kconfig
CONFIG_PM=n
CONFIG_PM_DEVICE=n
CONFIG_LOG=n
CONFIG_ASSERT=n
CONFIG_USE_SEGGER_RTT=n
CONFIG_IDLE_STACK_SIZE=128
CONFIG_ISR_STACK_SIZE=512
CONFIG_WATCHDOG=y

# ---- FAILSAFES: catch stack overflow / bad memory access cleanly (MPU guard +
# stack canary). Any fatal fault is turned into a reboot by k_sys_fatal_error_handler
# in main.c, and the 4 s watchdog is the final backstop for a hang. ----
# HK-613 (audit §2.5): the MPU stack guard is reprogrammed on every context
# switch (~1 % at the corner). Off; the STACK_SENTINEL canary below, which
# Kconfig had been silently excluding (depends on !MPU_STACK_GUARD), now
# takes effect -- overflow is caught at the next switch/ISR exit, not never.
CONFIG_HW_STACK_PROTECTION=n
CONFIG_STACK_SENTINEL=y
CONFIG_REBOOT=y
CONFIG_CLOCK_CONTROL=y
CONFIG_CLOCK_CONTROL_NRF_K32SRC_SYNTH=y

# ---- USB-serial diagnostics console (CDC ACM) ----
CONFIG_PRINTK=y
CONFIG_SERIAL=y
CONFIG_CONSOLE=y
CONFIG_UART_CONSOLE=y
CONFIG_UART_LINE_CTRL=y
CONFIG_UART_INTERRUPT_DRIVEN=y

# ---- Dual Deck: USB-C stereo mix capture to the host (UAC2) ----
# UAC2 only exists on the new stack, which is mutually exclusive with the legacy
# CONFIG_USB_DEVICE_STACK. The CDC console therefore moves to device_next too and
# enumerates as a composite (UAC2 stereo capture + CDC ACM) device.
CONFIG_USB_DEVICE_STACK_NEXT=y
CONFIG_USBD_AUDIO2_CLASS=y
CONFIG_USBD_CDC_ACM_CLASS=y
# SOF events submit stereo capture packets from the device mixer.
CONFIG_UDC_ENABLE_SOF=y
# The app owns the single composite USBD context; do NOT let the CDC SYS_INIT
# build a second private context that would fight for the controller.
CONFIG_CDC_ACM_SERIAL_INITIALIZE_AT_BOOT=n
# Serial-number string descriptor.
CONFIG_HWINFO=y
# Composite device identity (replaces the legacy VID/PID/strings). New PID so a
# host does not reuse a cached CDC-only driver from the old firmware.
CONFIG_SAMPLE_USBD_VID=0x1915
CONFIG_SAMPLE_USBD_PID=0x5210
CONFIG_SAMPLE_USBD_MANUFACTURER="softmodded"
CONFIG_SAMPLE_USBD_PRODUCT="Bonsai 8"
# WINDOWS: usbaudio2.sys demands a 4-byte Full-Speed feedback endpoint (the
# USB spec says 3) and a Q16.16 value — without this the device enumerates
# with a yellow triangle / Code 10 ("cannot start") on Windows. Linux and
# macOS parse the format from the declared size, so this is host-universal.
# (Backported into the Zephyr tree; upstream: USBD_UAC2_FS_WINDOWS_WORKAROUND,
# zephyrproject-rtos/zephyr issue #77212.)
CONFIG_USBD_UAC2_FS_WINDOWS_WORKAROUND=y
# Keep the existing read-only DDPROF? census available while resolving live
# tempo deadlines. Thread deltas distinguish planner/storage CPU from controls
# and audio preemption; elapsed planner slices alone cannot establish that.
CONFIG_THREAD_RUNTIME_STATS=y
CONFIG_SCHED_THREAD_USAGE=y
CONFIG_THREAD_MONITOR=y
CONFIG_THREAD_NAME=y
# iOS: iPhones/iPads reject accessories claiming more than 100 mA over the
# camera adapter. The SP-1 runs from its own battery and barely sips the bus,
# so claim 100 mA (units of 2 mA) instead of the 250 mA default.
CONFIG_SAMPLE_USBD_MAX_POWER=50

# ---- ADC for the button ladders / faders ----
CONFIG_ADC=y

# ---- Milestone 2: I2C to the audio codecs (CS42L42 / TAS2505) ----
CONFIG_I2C=y

# ---- Milestone 2b: I2S audio out (nRF master) ----
CONFIG_I2S=y
CONFIG_I2S_NRFX=y
CONFIG_FPU=y
# NOTE: deliberately NOT setting CONFIG_SPEED_OPTIMIZATIONS=y (-O2). It crashed the
# device on hardware -- this ae5b2e8-derived code has latent signed-overflow UB in
# the mixer interp that -O2 weaponizes. Default -Os is stable. Re-enabling -O2 would
# require fixing that UB (int64 interp) FIRST. Stay on -Os.

# USB stack + printf need a roomier main stack than the bare power build;
# device_next USBD init (descriptor build + class registration) wants headroom.
CONFIG_MAIN_STACK_SIZE=4096

# ---- Always-dim LEDs (fork): the soft-PWM LED timer ISR runs as a ZERO-
# LATENCY interrupt so kernel locks / other IRQs can't delay its on/off edges
# (edge jitter at low duty = visible flicker). The ISR is pure register IO. ----
CONFIG_ZERO_LATENCY_IRQS=y

# SS-473 (probe only -- reverted with prj.conf on exit)
CONFIG_INIT_STACKS=y
CONFIG_THREAD_STACK_INFO=y
```

## profile.conf
```kconfig
# Optional local diagnostic build; not needed for normal playback.
CONFIG_THREAD_RUNTIME_STATS=y
CONFIG_SCHED_THREAD_USAGE=y
CONFIG_THREAD_RUNTIME_STATS_USE_TIMING_FUNCTIONS=y
CONFIG_THREAD_MONITOR=y
CONFIG_THREAD_NAME=y
```

## src/bonsai_cdc.c
```c
/* SPDX-License-Identifier: MIT */
#include "bonsai_cdc.h"
#include <string.h>
_Static_assert((BONSAI_CDC_CAPACITY&(BONSAI_CDC_CAPACITY-1))==0,"power-of-two TX ring");
_Static_assert(ATOMIC_INT_LOCK_FREE==2,"CDC publication requires lock-free atomics");
void bonsai_cdc_reset(struct bonsai_cdc_tx *q)
{atomic_store(&q->read,0);atomic_store(&q->written,0);}
uint32_t bonsai_cdc_pending(const struct bonsai_cdc_tx *q)
{
 uint32_t w=atomic_load_explicit(&q->written,memory_order_acquire);
 uint32_t r=atomic_load_explicit(&q->read,memory_order_acquire);
 return w-r;
}
uint32_t bonsai_cdc_room(const struct bonsai_cdc_tx *q)
{uint32_t used=bonsai_cdc_pending(q);return used<=BONSAI_CDC_CAPACITY?BONSAI_CDC_CAPACITY-used:0;}
bool bonsai_cdc_write(struct bonsai_cdc_tx *q,const uint8_t *data,uint32_t count)
{
 if(count>BONSAI_CDC_CAPACITY||(count&&!data)||count>bonsai_cdc_room(q))return false;
 uint32_t w=atomic_load_explicit(&q->written,memory_order_relaxed);
 uint32_t at=w&(BONSAI_CDC_CAPACITY-1),first=BONSAI_CDC_CAPACITY-at;
 if(first>count)first=count;
 if(first)memcpy(q->bytes+at,data,first);
 if(first<count)memcpy(q->bytes,data+first,count-first);
 atomic_store_explicit(&q->written,w+count,memory_order_release);return true;
}
uint32_t bonsai_cdc_peek(const struct bonsai_cdc_tx *q,const uint8_t **data)
{
 uint32_t r=atomic_load_explicit(&q->read,memory_order_relaxed);
 uint32_t w=atomic_load_explicit(&q->written,memory_order_acquire),n=w-r;
 uint32_t at=r&(BONSAI_CDC_CAPACITY-1),span=BONSAI_CDC_CAPACITY-at;
 *data=q->bytes+at;
 if(n>BONSAI_CDC_CAPACITY)return 0;
 return n<span?n:span;
}
bool bonsai_cdc_consume(struct bonsai_cdc_tx *q,uint32_t count)
{
 uint32_t r=atomic_load_explicit(&q->read,memory_order_relaxed);
 uint32_t w=atomic_load_explicit(&q->written,memory_order_acquire);
 if(w-r>BONSAI_CDC_CAPACITY||count>w-r)return false;
 atomic_store_explicit(&q->read,r+count,memory_order_release);return true;
}
void bonsai_cdc_parser_reset(struct bonsai_cdc_parser *p)
{memset(p,0,sizeof(*p));}
bool bonsai_cdc_parse(struct bonsai_cdc_parser *p,uint8_t byte)
{
 static const char enter[]="SP1XFER!";
 if(p->pending!=BONSAI_CDC_IDLE)return false;
 p->enter_match=byte==(uint8_t)enter[p->enter_match]?p->enter_match+1:byte=='S'?1:0;
 if(p->enter_match==8){p->pending=BONSAI_CDC_ENTER;p->enter_match=0;return true;}
 if(byte=='\n') {
  p->line[p->used]=0;
  if(!p->overflow) {
   if(!strcmp(p->line,"DDSTAT?"))p->pending=BONSAI_CDC_STATUS;
   else if(!strcmp(p->line,"DDMIR?"))p->pending=BONSAI_CDC_MIRROR;
   else if(!strcmp(p->line,"DDLIB?"))p->pending=BONSAI_CDC_LIBRARY;
   else if(!strcmp(p->line,"DDPROF?"))p->pending=BONSAI_CDC_PROFILE;
   else if(!strncmp(p->line,"DDLOAD ",7))p->pending=BONSAI_CDC_LOAD;
  }
  if(p->pending==BONSAI_CDC_IDLE){p->used=0;p->overflow=false;}
 } else if(byte!='\r') {
  if(p->used<sizeof(p->line)-1)p->line[p->used++]=(char)byte;
  else p->overflow=true;
 }
 return true;
}
bool bonsai_cdc_admissible(const struct bonsai_cdc_parser *p,const struct bonsai_cdc_tx *q)
{
 if(p->pending==BONSAI_CDC_IDLE)return false;
 if(p->pending==BONSAI_CDC_ENTER)return bonsai_cdc_pending(q)==0;
 return bonsai_cdc_room(q)>=BONSAI_CDC_REPLY_MAX;
}
```

## src/bonsai_cdc.h
```c
/* SPDX-License-Identifier: MIT */
#ifndef BONSAI_CDC_H
#define BONSAI_CDC_H
#include <stdbool.h>
#include <stddef.h>
#include <stdint.h>
#include <stdatomic.h>

#define BONSAI_CDC_CAPACITY 4096u
#define BONSAI_CDC_REPLY_MAX 2048u
#define BONSAI_CDC_RX_BUDGET 64u
#define BONSAI_CDC_COMMAND_SIZE 40u

/* One storage-thread producer, one CDC callback consumer. Admission is all or
 * nothing; publication follows the complete copy. Source memory is not retained.
 * Reset requires both owners excluded. No driver calls, allocation or sleeps. */
struct bonsai_cdc_tx {
 uint8_t bytes[BONSAI_CDC_CAPACITY];
 _Atomic uint32_t written,read;
};
void bonsai_cdc_reset(struct bonsai_cdc_tx *q);
uint32_t bonsai_cdc_pending(const struct bonsai_cdc_tx *q);
uint32_t bonsai_cdc_room(const struct bonsai_cdc_tx *q);
bool bonsai_cdc_write(struct bonsai_cdc_tx *q,const uint8_t *data,uint32_t count);
/* Consumer obtains one contiguous span, then consumes only the driver's actual
 * accepted byte count. A zero/partial acceptance never discards the remainder. */
uint32_t bonsai_cdc_peek(const struct bonsai_cdc_tx *q,const uint8_t **data);
bool bonsai_cdc_consume(struct bonsai_cdc_tx *q,uint32_t count);

enum bonsai_cdc_command { BONSAI_CDC_IDLE, BONSAI_CDC_STATUS,
 BONSAI_CDC_MIRROR, BONSAI_CDC_LIBRARY, BONSAI_CDC_LOAD,
 BONSAI_CDC_PROFILE, BONSAI_CDC_ENTER };
struct bonsai_cdc_parser {
 char line[BONSAI_CDC_COMMAND_SIZE];
 uint8_t used,enter_match;
 bool overflow;
 enum bonsai_cdc_command pending;
};
void bonsai_cdc_parser_reset(struct bonsai_cdc_parser *p);
/* false means a command is already pending: caller must not remove a new byte
 * from RX. Malformed/overlong lines have no side effects. Transfer magic retains
 * its existing un-delimited form. One pending command bounds work per refill. */
bool bonsai_cdc_parse(struct bonsai_cdc_parser *p,uint8_t byte);
bool bonsai_cdc_admissible(const struct bonsai_cdc_parser *p,
                          const struct bonsai_cdc_tx *q);
#endif
```

## src/bonsai_fx.c
```c
/* SPDX-License-Identifier: MIT */
#include "bonsai_fx.h"
#include <string.h>

_Static_assert(sizeof(struct bonsai_fx) == 224u,
               "Eight-stem filter bank exceeds its fixed 224-byte RAM budget");
_Static_assert(ATOMIC_INT_LOCK_FREE == 2, "FX controls require lock-free atomics");

void bonsai_fx_init(struct bonsai_fx *fx)
{
 memset(fx->voice, 0, sizeof(fx->voice));
 for (unsigned i = 0; i < BONSAI_FX_VOICES; ++i)
  atomic_init(&fx->config[i], 0);
}
bool bonsai_fx_reset_voice(struct bonsai_fx *fx, unsigned voice)
{
 if (voice >= BONSAI_FX_VOICES) return false;
 struct bonsai_fx_voice *v = &fx->voice[voice];
 v->type = v->requested_type = BONSAI_FX_NONE;
 v->requested_amount = v->mix = v->alpha = v->target_alpha = 0;
 v->low_l = v->low_r = 0;
 v->filter_seeded = false;
 return true;
}
bool bonsai_fx_set(struct bonsai_fx *fx, unsigned voice,
                   enum bonsai_fx_type type, unsigned amount)
{
 if (voice >= BONSAI_FX_VOICES || (unsigned)type > BONSAI_FX_FILTER) return false;
 if (amount > 256u) amount = 256u;
 if (type == BONSAI_FX_NONE) amount = 0;
 atomic_store_explicit(&fx->config[voice], ((uint32_t)type << 16) | amount,
                       memory_order_release);
 return true;
}
void bonsai_fx_begin_block(struct bonsai_fx *fx)
{
 /* Bilinear, Nyquist-normalized one-pole high-pass coefficients. Seventeen
  * log-spaced cutoff anchors cover 60 Hz -> 8 kHz; Q8 endpoints are 59.9 Hz
  * and 7978 Hz. The lower bound retains useful bass resolution in 32-bit DSP. */
 static const uint16_t alpha[17] = {
  2,3,4,5,7,9,12,17,22,30,40,52,69,90,116,148,187
 };
 for (unsigned i = 0; i < BONSAI_FX_VOICES; ++i) {
  struct bonsai_fx_voice *v = &fx->voice[i];
  uint32_t config = atomic_load_explicit(&fx->config[i], memory_order_acquire);
  unsigned amount = config & 0xffffu, type = config >> 16;
  /* Invalid directly-written/corrupted configurations fail closed to bypass.
   * The public setter rejects retired IDs 2/3 without changing any setting. */
  if (type > BONSAI_FX_FILTER || amount > 256u) { type = BONSAI_FX_NONE; amount = 0; }
  v->requested_type = amount ? (uint8_t)type : BONSAI_FX_NONE;
  v->requested_amount = (uint16_t)amount;
  if (v->requested_type == BONSAI_FX_FILTER) {
   unsigned index = amount / 16u, part = amount % 16u;
   v->target_alpha = index == 16u ? alpha[16] :
    (uint16_t)((alpha[index] * (16u - part) + alpha[index + 1u] * part) / 16u);
  }
 }
}

static void activate(struct bonsai_fx_voice *v)
{
 v->type = v->requested_type;
 v->mix = 0;
 if (v->type == BONSAI_FX_FILTER) v->alpha = v->target_alpha;
 v->filter_seeded = false;
}
static int32_t lowpass(int32_t previous, int16_t sample, uint16_t alpha)
{
 int32_t difference = (int32_t)sample * 256 - previous;
 uint32_t magnitude = (uint32_t)(difference < 0 ? -difference : difference);
 /* Q8 state retains quiet-signal precision. The unsigned product fits:
  * maximum magnitude=65535*256, coefficient<=232. No 64-bit DSP. */
 int32_t step = (int32_t)((magnitude * alpha) >> 8);
 return previous + (difference < 0 ? -step : step);
}
static int32_t lowpass_small_alpha(int32_t previous,int16_t sample,uint16_t alpha)
{
 /* The state stays inside int16 * 256. For alpha <= 128 the signed product
  * is bounded by 65535 * 256 * 128 = 2147450880, below INT32_MAX.
  * C's division truncates toward zero, exactly matching the magnitude path.
  * Hoisting the coefficient bound outside a steady block saves sign/absolute
  * reconstruction on both channels without changing a sample or tone. */
 int32_t difference=(int32_t)sample*256-previous;
 return previous+difference*alpha/256;
}
static void advance_filter(struct bonsai_fx_voice *v)
{
 /* One Q8 coefficient step per sample bounds a full-range sweep to 3.86 ms.
  * The steady buffer path hoists this check once it reaches its target. */
 if (v->alpha < v->target_alpha) ++v->alpha;
 else if (v->alpha > v->target_alpha) --v->alpha;
}
static int32_t highpass(int16_t input,int32_t previous,uint16_t alpha)
{
 /* beta=(1+p)/2=(512-alpha)/512 gives unity Nyquist gain, without resonance
  * or a blanket wet attenuation. Difference <=65535; product <=33422850.
  * Preserve wide polarity transients until stem gain and final bus limiting. */
 return ((int32_t)input-previous/256)*(512-alpha)/512;
}
struct dd_wide_frame bonsai_fx_process(struct bonsai_fx_voice *v,
                                  struct dd_frame input)
{
 if (v->type != v->requested_type && !v->mix) activate(v);
 if (v->type == BONSAI_FX_NONE) return (struct dd_wide_frame){input.l,input.r};
 unsigned target = v->type != v->requested_type ? 0 : 256;
 if (v->mix < target) ++v->mix;
 else if (v->mix > target) --v->mix;
 advance_filter(v);
 if (!v->filter_seeded) {
  v->low_l = (int32_t)input.l * 256;
  v->low_r = (int32_t)input.r * 256;
  v->filter_seeded = true;
 }
 int32_t hl=highpass(input.l,v->low_l,v->alpha);
 int32_t hr=highpass(input.r,v->low_r,v->alpha);
 v->low_l = lowpass(v->low_l, input.l, v->alpha);
 v->low_r = lowpass(v->low_r, input.r, v->alpha);
 return (struct dd_wide_frame){
  input.l+(hl-input.l)*v->mix/256,
  input.r+(hr-input.r)*v->mix/256
 };
}

void bonsai_fx_process_buffer(struct bonsai_fx_voice *v,
                              struct dd_wide_frame *frames, uint32_t count)
{
 uint32_t i=0;
 for(;i<count;i++) {
  if(v->type==v->requested_type) {
   if(v->type==BONSAI_FX_NONE) return;
   if(v->mix==256&&v->filter_seeded) break;
  }
  frames[i]=bonsai_fx_process(v,(struct dd_frame){frames[i].l,frames[i].r});
 }
 if(i==count) return;
 int32_t l=v->low_l,r=v->low_r;
 for(;i<count&&v->alpha!=v->target_alpha;i++) {
  advance_filter(v);
  struct dd_frame input={frames[i].l,frames[i].r};
  frames[i]=(struct dd_wide_frame){highpass(input.l,l,v->alpha),highpass(input.r,r,v->alpha)};
  l=lowpass(l,input.l,v->alpha);r=lowpass(r,input.r,v->alpha);
 }
 uint16_t alpha=v->alpha;
 if(alpha<=128u) {
  for(;i<count;i++) {
   struct dd_frame input={frames[i].l,frames[i].r};
   frames[i]=(struct dd_wide_frame){highpass(input.l,l,alpha),highpass(input.r,r,alpha)};
   l=lowpass_small_alpha(l,input.l,alpha);r=lowpass_small_alpha(r,input.r,alpha);
  }
 } else {
  for(;i<count;i++) {
   struct dd_frame input={frames[i].l,frames[i].r};
   frames[i]=(struct dd_wide_frame){highpass(input.l,l,alpha),highpass(input.r,r,alpha)};
   l=lowpass(l,input.l,alpha);r=lowpass(r,input.r,alpha);
  }
 }
 v->low_l=l;v->low_r=r;
}
```

## src/bonsai_fx.h
```c
/* SPDX-License-Identifier: MIT */
#ifndef BONSAI_FX_H
#define BONSAI_FX_H
#include "dual_engine.h"

#define BONSAI_FX_VOICES 8u
enum bonsai_fx_type {
 BONSAI_FX_NONE = 0,
 BONSAI_FX_FILTER = 1
};
struct bonsai_fx_voice {
 int32_t low_l, low_r;
 uint16_t mix, requested_amount, alpha, target_alpha;
 uint8_t type, requested_type;
 bool filter_seeded;
 uint32_t clipped;
};
struct bonsai_fx {
 struct bonsai_fx_voice voice[BONSAI_FX_VOICES];
 _Atomic uint32_t config[BONSAI_FX_VOICES];
};

/* init requires exclusive access. set is nonblocking/control-thread safe;
 * amount is 0..256, clamped. Filter is the only supported effect. Retired
 * numeric IDs 2/3 are rejected, even at zero amount, without changing config.
 * Configurations persist until set again; button release has no core action. */
void bonsai_fx_init(struct bonsai_fx *fx);
/* Song-load hook: requires audio exclusion, preserves the atomic selected
 * filter/amount and cumulative clip counter, and removes old song state. */
bool bonsai_fx_reset_voice(struct bonsai_fx *fx, unsigned voice);
bool bonsai_fx_set(struct bonsai_fx *fx, unsigned voice,
                   enum bonsai_fx_type type, unsigned amount);
/* Audio owner snapshots settings once before rendering an output block.
 * Invalid directly-written config IDs/amounts fail closed to a bypass fade. */
void bonsai_fx_begin_block(struct bonsai_fx *fx);
/* Audio owner, once per 48 kHz frame per voice, before stem gain/mute. Call
 * even for currently muted voices to keep their filter state progressing.
 * Bypass preserves stereo exactly after a <=256-frame (5.33 ms) fade-out.
 *
 * FILTER: independent stereo one-pole high-pass. Increasing amount sweeps
 * cutoff from approximately 60 Hz to 8 kHz, removing bass and retaining highs.
 * Its normalized passband has unity gain at Nyquist, with no resonance boost.
 * Filter coefficient changes ramp over at most 185 frames (3.86 ms).
 * Output uses int32 headroom through stem gain and the two-deck sum; full-scale
 * polarity transients can exceed int16 but do not clip or wrap before the
 * final engine bus clamp. Source input must remain int16 stereo.
 */
struct dd_wide_frame bonsai_fx_process(struct bonsai_fx_voice *v,
                                  struct dd_frame input);
/* Same samples and state as repeated process calls, in place. Settings stay
 * fixed until the next begin_block. Input frame values must be in int16 range;
 * the in-place output is wide. Steady filters avoid transition checks and
 * crossfades in the inner loop; transitions use the scalar path. */
void bonsai_fx_process_buffer(struct bonsai_fx_voice *v,
                              struct dd_wide_frame *frames, uint32_t count);
#endif
```

## src/bonsai_library.c
```c
/* SPDX-License-Identifier: MIT */
#include "bonsai_library.h"
#include <string.h>

/* Little-endian on-card layout from main.c's meta_blk/slot_state/x3_tab;
 * explicit byte access avoids native alignment, packing and endian dependence.
 * tools/sp1.py update_song uses the same offsets. */
enum {
 META_MAGIC=0x53453341u, X3_MAGIC=0x53453358u,
 META_SLOT=8, SLOT_BYTES=44, META_CONTENT=716, META_CHOP=976,
 META_SONG_MODE=1008, X3_ROWS=16, X3_SLOT_BYTES=64, X3_ROWS_END=1040
};
static uint16_t read16(const uint8_t *p)
{ return (uint16_t)((uint16_t)p[0]|(uint16_t)p[1]<<8); }
static uint32_t read32(const uint8_t *p)
{ return (uint32_t)p[0]|(uint32_t)p[1]<<8|(uint32_t)p[2]<<16|(uint32_t)p[3]<<24; }
static void write16(uint8_t *p,uint16_t n)
{ p[0]=(uint8_t)n;p[1]=(uint8_t)(n>>8); }
static void write32(uint8_t *p,uint32_t n)
{ p[0]=(uint8_t)n;p[1]=(uint8_t)(n>>8);p[2]=(uint8_t)(n>>16);p[3]=(uint8_t)(n>>24); }
static uint16_t checksum(const uint8_t *x3)
{
 uint16_t sum=0;
 for(unsigned i=X3_ROWS;i<X3_ROWS_END;i++) sum=(uint16_t)(sum+x3[i]);
 return sum;
}
static bool zero(const uint8_t *p,unsigned n)
{
 for(unsigned i=0;i<n;i++) if(p[i]) return false;
 return true;
}
static bool valid_empty(const uint8_t *meta,const uint8_t *x3,uint32_t slot)
{
 if(!meta||!x3||slot>=BONSAI_LIBRARY_SLOTS) return false;
 if(read32(meta)!=META_MAGIC||read32(meta+4)>=BONSAI_LIBRARY_SLOTS||
    read32(x3)!=X3_MAGIC||read16(x3+4)!=1||read16(x3+6)!=checksum(x3)) return false;
 return zero(meta+META_SLOT+slot*SLOT_BYTES+8,4);
}
static bool valid_length(uint32_t frames,uint32_t sectors)
{
 return frames&&frames<=BONSAI_LIBRARY_MAX_NATIVE_FRAMES&&
  sectors&&sectors<=BONSAI_LIBRARY_TRACK_SECTORS&&
  sectors==frames/BONSAI_LIBRARY_SECTOR_FRAMES+
           (frames%BONSAI_LIBRARY_SECTOR_FRAMES!=0);
}
bool bonsai_library_prepare(uint8_t meta[BONSAI_LIBRARY_META_BYTES],
                            uint8_t x3[BONSAI_LIBRARY_X3_BYTES],uint32_t slot,
                            uint32_t frames,uint32_t sectors)
{
 if(!valid_empty(meta,x3,slot)||!valid_length(frames,sectors)) return false;
 uint8_t *song=meta+META_SLOT+slot*SLOT_BYTES;
 uint8_t *content=meta+META_CONTENT+slot*16;
 uint8_t *rows=x3+X3_ROWS+slot*X3_SLOT_BYTES;
 memset(song,0,SLOT_BYTES);write32(song,65536);write32(song+4,frames*2);
 write32(song+12,sectors);
 memset(content,0,16);write32(content,sectors);
 memset(meta+META_CHOP+slot*2,0,2);meta[META_SONG_MODE+slot]=0;
 memset(rows,0,X3_SLOT_BYTES);
 write32(rows+4,frames*2);write32(rows+8,sectors);
 rows[12]=5;rows[13]=1;rows[14]=128;
 write16(x3+6,checksum(x3));
 return true;
}
bool bonsai_library_publish(uint8_t meta[BONSAI_LIBRARY_META_BYTES],
                            const uint8_t x3[BONSAI_LIBRARY_X3_BYTES],uint32_t slot)
{
 if(!valid_empty(meta,x3,slot)) return false;
 uint8_t *song=meta+META_SLOT+slot*SLOT_BYTES;
 const uint8_t *content=meta+META_CONTENT+slot*16;
 const uint8_t *rows=x3+X3_ROWS+slot*X3_SLOT_BYTES;
 uint32_t length=read32(song+4),sectors=read32(song+12);
 if((length&1)||!valid_length(length/2,sectors)||read32(song)!=65536||
    !zero(song+16,28)||read32(content)!=sectors||!zero(content+4,12)||
    !zero(meta+META_CHOP+slot*2,2)||meta[META_SONG_MODE+slot]||
    read32(rows)!=0||read32(rows+4)!=length||read32(rows+8)!=sectors||
    rows[12]!=5||rows[13]!=1||rows[14]!=128||rows[15]||
    !zero(rows+16,48)) return false;
 song[8]=1;
 return true;
}
```

## src/bonsai_library.h
```c
/* SPDX-License-Identifier: MIT */
#ifndef BONSAI_LIBRARY_H
#define BONSAI_LIBRARY_H
#include <stdbool.h>
#include <stdint.h>

#define BONSAI_LIBRARY_META_BYTES 1024u
#define BONSAI_LIBRARY_X3_BYTES 1536u
#define BONSAI_LIBRARY_SLOTS 16u
#define BONSAI_LIBRARY_SECTOR_FRAMES 140u
#define BONSAI_LIBRARY_MAX_NATIVE_FRAMES (35840u * 643u / 2u)
#define BONSAI_LIBRARY_TRACK_SECTORS 86016u

/* Prepare an EMPTY slot for one stereo P14S recording at 24 kHz, on stem 1.
 * Both buffers must contain the complete current on-device metadata images.
 * Checks the existing index signature, slot selection and X3 version/checksum;
 * never repairs/reinitializes invalid metadata or replaces an occupied slot.
 * sectors must equal ceil(native_frames / 140), within the supported length.
 * Success leaves all four presence flags zero: this stage is NOT playable.
 * All unrelated bytes, including reserved headers/settings/tails, survive.
 * Any false result leaves both buffers byte-for-byte unchanged.
 * These helpers perform no storage IO and require exclusive buffer ownership. */
bool bonsai_library_prepare(uint8_t meta[BONSAI_LIBRARY_META_BYTES],
                            uint8_t x3[BONSAI_LIBRARY_X3_BYTES],uint32_t slot,
                            uint32_t native_frames,uint32_t sectors);

/* Call only after the audio and prepared X3/index have been written, flushed
 * and verified. Validates the unpublished single-stem layout, then changes
 * ONLY this slot's stem-1 presence byte to 1. The caller still must persist
 * and verify that final index write. The helper cannot verify stored audio.
 * Returns false without mutation if the slot is occupied or not prepared. */
bool bonsai_library_publish(uint8_t meta[BONSAI_LIBRARY_META_BYTES],
                            const uint8_t x3[BONSAI_LIBRARY_X3_BYTES],uint32_t slot);
#endif
```

## src/bonsai_playlist.c
```c
/* SPDX-License-Identifier: MIT */
#include "bonsai_playlist.h"
#include <stddef.h>
#include <string.h>
static uint32_t u32(const uint8_t *p){return (uint32_t)p[0]|(uint32_t)p[1]<<8|(uint32_t)p[2]<<16|(uint32_t)p[3]<<24;}
static uint32_t crc(uint32_t c,const uint8_t *p,size_t n){
 while(n--){c^=*p++;for(unsigned b=0;b<8;b++)c=(c>>1)^(0xedb88320u& (0u-(c&1u)));}return c;
}
bool bonsai_playlist_decode(const uint8_t bank[512],struct bonsai_playlist *out){
 if(memcmp(bank,"B8PL",4)||u32(bank+4)!=1u||u32(bank+508)!=~crc(~0u,bank,508))return false;
 if(u32(bank+12))return false;
 for(unsigned i=144;i<508;i++)if(bank[i])return false;
 for(unsigned i=0;i<16;i++){
  uint32_t r=u32(bank+16+i*8),bpm=r&65535u;
  if((r&~0x3ffffu)||(bpm&&(bpm<2000u||bpm>40000u)))return false;
 }
 if(out){out->generation=u32(bank+8);for(unsigned i=0;i<16;i++){out->row[i]=u32(bank+16+i*8);out->identity[i]=u32(bank+20+i*8);}}
 return true;
}
int bonsai_playlist_bank(const uint8_t banks[1024]){
 bool a=bonsai_playlist_decode(banks,NULL),b=bonsai_playlist_decode(banks+512,NULL);
 if(!a)return b?1:-1;
 if(!b)return 0;
 uint32_t delta=u32(banks+520)-u32(banks+8);
 return delta&&delta<0x80000000u?1:0;
}
uint32_t bonsai_playlist_identity(const uint8_t meta[1024],const uint8_t x3[1040],unsigned slot){
 if(slot>=16)return 0;
 uint32_t c=crc(~0u,meta+8+slot*44,44);
 c=crc(c,meta+716+slot*16,16);return ~crc(c,x3+16+slot*64,64);
}
static uint32_t key(uint32_t row,unsigned slot){uint32_t bpm=row&65535u;return ((bpm?bpm:65536u)<<4)|slot;}
int bonsai_playlist_next(const uint32_t rows[16],uint16_t present,unsigned deck,int current,int direction){
 if(deck>1||!direction)return -1;
 uint32_t mask=1u<<(16+deck);int edge=-1,next=-1;
 uint32_t current_key=current>=0&&current<16?key(rows[current],(unsigned)current):0;
 for(unsigned s=0;s<16;s++)if((present&(1u<<s))&&(rows[s]&mask)){
  uint32_t k=key(rows[s],s);
  if(edge<0||(direction>0?k<key(rows[edge],(unsigned)edge):k>key(rows[edge],(unsigned)edge)))edge=(int)s;
  if(current>=0&&current<16&&(direction>0?k>current_key:k<current_key)&&
     (next<0||(direction>0?k<key(rows[next],(unsigned)next):k>key(rows[next],(unsigned)next))))next=(int)s;
 }
 return next<0?edge:next;
}
```

## src/bonsai_playlist.h
```c
/* SPDX-License-Identifier: MIT */
#ifndef BONSAI_PLAYLIST_H
#define BONSAI_PLAYLIST_H
#include <stdbool.h>
#include <stdint.h>

/* Bonsai's versioned extension to the supported SE3A layout. Index: 0..1,
 * grids: 2, X3: 3..5, playlists: 6..7, fixed audio starts at 4096.
 * Two alternating banks; never write an unrecognized nonblank bank. */
#define BONSAI_PLAYLIST_BLOCK 6u
#define BONSAI_PLAYLIST_BYTES 512u
#define BONSAI_PLAYLIST_SLOTS 16u
#define BONSAI_PLAYLIST_DEFAULT (3u << 16)
struct bonsai_playlist {
 uint32_t generation;
 uint32_t row[16]; /* BPM in hundredths, membership A/B in bits 16/17. */
 uint32_t identity[16]; /* Descriptor fingerprint, NOT an audio-content hash. */
};
bool bonsai_playlist_decode(const uint8_t bank[512],struct bonsai_playlist *out);
/* -1: neither valid. Generation comparison tolerates uint32 wrap. */
int bonsai_playlist_bank(const uint8_t banks[1024]);
uint32_t bonsai_playlist_identity(const uint8_t meta[1024],const uint8_t x3[1040],unsigned slot);
/* Occupied slots only; unknown BPM last, equal BPM in physical slot order.
 * Returns -1 for an empty playlist. Current song need not be a member. */
int bonsai_playlist_next(const uint32_t rows[16],uint16_t present,unsigned deck,int current,int direction);
#endif
```

## src/bonsai_record.c
```c
/* SPDX-License-Identifier: MIT */
#include "bonsai_record.h"
#include <string.h>

_Static_assert((BONSAI_RECORD_RING & (BONSAI_RECORD_RING - 1u)) == 0,
               "Recording ring must have a power-of-two size");
_Static_assert(ATOMIC_INT_LOCK_FREE == 2 && ATOMIC_BOOL_LOCK_FREE == 2,
               "Audio producer atomics must never use blocking locks");
_Static_assert(sizeof(struct bonsai_record) <= 33024,
               "Recording core must fit its 32 KiB ring and small state budget");

void bonsai_record_init(struct bonsai_record *r)
{
 atomic_init(&r->written, 0);
 atomic_init(&r->read, 0);
 atomic_init(&r->source_frames, 0);
 atomic_init(&r->committed_frames, 0);
 atomic_init(&r->committed_sectors, 0);
 atomic_init(&r->state, BONSAI_RECORD_IDLE);
 atomic_init(&r->error, BONSAI_RECORD_OK);
 atomic_init(&r->stop_requested, false);
 r->half = (struct dd_frame){0, 0};
 r->have_half = false;
 r->pending_frames = 0;
}

bool bonsai_record_start(struct bonsai_record *r)
{
 unsigned state = atomic_load_explicit(&r->state, memory_order_relaxed);
 if (state == BONSAI_RECORD_ACTIVE || state == BONSAI_RECORD_DRAINING)
  return false;
 bonsai_record_init(r);
 atomic_store_explicit(&r->state, BONSAI_RECORD_ACTIVE, memory_order_release);
 return true;
}

void bonsai_record_request_stop(struct bonsai_record *r)
{
 atomic_store_explicit(&r->stop_requested, true, memory_order_release);
}

void bonsai_record_fail(struct bonsai_record *r,
                        enum bonsai_record_error error)
{
 unsigned expected = BONSAI_RECORD_OK;
 if (error == BONSAI_RECORD_OK) error = BONSAI_RECORD_STORAGE_ERROR;
 atomic_compare_exchange_strong_explicit(&r->error, &expected, error,
                                         memory_order_relaxed,
                                         memory_order_relaxed);
 atomic_store_explicit(&r->state, BONSAI_RECORD_FAILED, memory_order_release);
}

static void finish_producer(struct bonsai_record *r)
{
 if (r->have_half) {
  uint32_t w = atomic_load_explicit(&r->written, memory_order_relaxed);
  uint32_t rd = atomic_load_explicit(&r->read, memory_order_acquire);
  if (w - rd == BONSAI_RECORD_RING) {
   bonsai_record_fail(r, BONSAI_RECORD_OVERFLOW);
   return;
  }
  r->ring[w & (BONSAI_RECORD_RING - 1u)] = r->half;
  r->have_half = false;
  atomic_store_explicit(&r->written, w + 1u, memory_order_release);
 }
 unsigned expected = BONSAI_RECORD_ACTIVE;
 atomic_compare_exchange_strong_explicit(&r->state, &expected,
                                         BONSAI_RECORD_DRAINING,
                                         memory_order_release,
                                         memory_order_relaxed);
}

bool bonsai_record_push48(struct bonsai_record *r, const int16_t *stereo,
                          uint32_t frames)
{
 if (atomic_load_explicit(&r->state, memory_order_acquire) !=
     BONSAI_RECORD_ACTIVE) return false;
 if (atomic_load_explicit(&r->stop_requested, memory_order_acquire)) {
  finish_producer(r);
  return false;
 }
 uint32_t w = atomic_load_explicit(&r->written, memory_order_relaxed);
 uint32_t rd = atomic_load_explicit(&r->read, memory_order_acquire);
 /* Reject oversized input before frames+1 or stereo indexing can overflow. */
 uint32_t produced = frames / 2u + (r->have_half && (frames & 1u));
 if (produced > BONSAI_RECORD_RING ||
     w - rd > BONSAI_RECORD_RING - produced) {
  bonsai_record_fail(r, BONSAI_RECORD_OVERFLOW);
  return false;
 }
 for (uint32_t i = 0; i < frames; ++i) {
  struct dd_frame next = {stereo[i * 2u], stereo[i * 2u + 1u]};
  if (!r->have_half) {
   r->half = next;
   r->have_half = true;
  } else {
   struct dd_frame average = {
    (int16_t)(((int32_t)r->half.l + next.l) / 2),
    (int16_t)(((int32_t)r->half.r + next.r) / 2)
   };
   r->ring[w++ & (BONSAI_RECORD_RING - 1u)] = average;
   r->have_half = false;
  }
 }
 atomic_fetch_add_explicit(&r->source_frames, frames, memory_order_relaxed);
 atomic_store_explicit(&r->written, w, memory_order_release);
 if (atomic_load_explicit(&r->stop_requested, memory_order_acquire))
  finish_producer(r);
 return atomic_load_explicit(&r->state, memory_order_acquire) ==
        BONSAI_RECORD_ACTIVE;
}

/* Python pack_block uses signed sample >> 2: floor division by four, even
 * for negative samples. Express it portably without signed right shifts. */
static uint16_t quantize(int16_t sample)
{
 int32_t s = sample;
 int32_t q = s >= 0 ? s / 4 : -((-s + 3) / 4);
 return (uint16_t)q & 0x3fffu;
}

static void complete_if_empty(struct bonsai_record *r)
{
 /* Acquire producer completion before checking indices: it must not be able
  * to append its final half-frame after this empty check. */
 if (atomic_load_explicit(&r->state, memory_order_acquire) !=
     BONSAI_RECORD_DRAINING) return;
 if (atomic_load_explicit(&r->read, memory_order_relaxed) !=
     atomic_load_explicit(&r->written, memory_order_acquire)) return;
 unsigned expected = BONSAI_RECORD_DRAINING;
 atomic_compare_exchange_strong_explicit(&r->state, &expected,
                                         BONSAI_RECORD_COMPLETE,
                                         memory_order_release,
                                         memory_order_relaxed);
}

uint32_t bonsai_record_peek_sector(struct bonsai_record *r, uint8_t out[512])
{
 unsigned state = atomic_load_explicit(&r->state, memory_order_acquire);
 if (state != BONSAI_RECORD_ACTIVE && state != BONSAI_RECORD_DRAINING)
  return 0;
 uint32_t rd = atomic_load_explicit(&r->read, memory_order_relaxed);
 uint32_t available = atomic_load_explicit(&r->written, memory_order_acquire) - rd;
 if (!r->pending_frames) {
  if (!available) { complete_if_empty(r); return 0; }
  if (available < BONSAI_RECORD_SECTOR_FRAMES &&
      state != BONSAI_RECORD_DRAINING) return 0;
  r->pending_frames = available < BONSAI_RECORD_SECTOR_FRAMES ?
                      available : BONSAI_RECORD_SECTOR_FRAMES;
 }
 memset(out, 0, 512);
 memcpy(out, "P14S", 4);
 out[5] = 1;
 out[11] = 0x5b;
 out[12] = 0x18; out[13] = 0x01; /* 280 interleaved samples. */
 for (uint32_t i = 0; i < BONSAI_RECORD_SECTOR_FRAMES; i += 2u) {
  struct dd_frame first = i < r->pending_frames ?
   r->ring[(rd + i) & (BONSAI_RECORD_RING - 1u)] : (struct dd_frame){0, 0};
  struct dd_frame second = i + 1u < r->pending_frames ?
   r->ring[(rd + i + 1u) & (BONSAI_RECORD_RING - 1u)] : (struct dd_frame){0, 0};
  uint16_t a = quantize(first.l), b = quantize(first.r);
  uint16_t c = quantize(second.l), d = quantize(second.r);
  uint8_t *p = out + 16u + i / 2u * 7u;
  p[0] = a >> 6;
  p[1] = (uint8_t)((a << 2) | (b >> 12));
  p[2] = b >> 4;
  p[3] = (uint8_t)((b << 4) | (c >> 10));
  p[4] = c >> 2;
  p[5] = (uint8_t)((c << 6) | (d >> 8));
  p[6] = (uint8_t)d;
 }
 return r->pending_frames;
}

bool bonsai_record_commit_sector(struct bonsai_record *r)
{
 unsigned state = atomic_load_explicit(&r->state, memory_order_acquire);
 if (!r->pending_frames || (state != BONSAI_RECORD_ACTIVE &&
                           state != BONSAI_RECORD_DRAINING)) return false;
 uint32_t rd = atomic_load_explicit(&r->read, memory_order_relaxed);
 atomic_fetch_add_explicit(&r->committed_frames, r->pending_frames,
                           memory_order_relaxed);
 atomic_fetch_add_explicit(&r->committed_sectors, 1, memory_order_relaxed);
 atomic_store_explicit(&r->read, rd + r->pending_frames, memory_order_release);
 r->pending_frames = 0;
 complete_if_empty(r);
 return true;
}
```

## src/bonsai_record.h
```c
/* SPDX-License-Identifier: MIT */
#ifndef BONSAI_RECORD_H
#define BONSAI_RECORD_H
#include "dual_engine.h"

#define BONSAI_RECORD_RING 8192u
#define BONSAI_RECORD_SECTOR_FRAMES 140u

enum bonsai_record_state {
 BONSAI_RECORD_IDLE,
 BONSAI_RECORD_ACTIVE,
 BONSAI_RECORD_DRAINING,
 BONSAI_RECORD_COMPLETE,
 BONSAI_RECORD_FAILED
};
enum bonsai_record_error {
 BONSAI_RECORD_OK,
 BONSAI_RECORD_OVERFLOW,
 BONSAI_RECORD_STORAGE_ERROR
};
struct bonsai_record {
 struct dd_frame ring[BONSAI_RECORD_RING];
 _Atomic uint32_t written, read;
 _Atomic uint32_t source_frames, committed_frames, committed_sectors;
 _Atomic unsigned state, error;
 _Atomic bool stop_requested;
 /* Audio producer only. */
 struct dd_frame half;
 bool have_half;
 /* Storage consumer only. Pending frames remain in the ring until committed. */
 uint32_t pending_frames;
};

/* Initialization and start require exclusive access to producer and consumer.
 * start refuses to discard an active/draining take; it resets completed/failed
 * takes. No allocation, USB, storage IO or blocking occurs in this module. */
void bonsai_record_init(struct bonsai_record *r);
bool bonsai_record_start(struct bonsai_record *r);

/* Nonblocking control request. The audio producer MUST continue calling push48
 * (zero frames / NULL is sufficient) until it acknowledges stop as DRAINING.
 * A final unpaired 48 kHz frame is retained as one native 24 kHz frame. */
void bonsai_record_request_stop(struct bonsai_record *r);
/* Single audio producer: the final stereo 48 kHz mix. Adjacent pairs average
 * toward zero into 24 kHz frames, including pairs split between calls.
 * false means inactive/stopped/failed. Overflow fails the entire take; never
 * publish metadata for a failed take, even if earlier sectors were written. */
bool bonsai_record_push48(struct bonsai_record *r, const int16_t *stereo,
                          uint32_t frames);

/* Single storage consumer. peek does not release ring space. Repeated peeks
 * yield the same sector until commit, so a write can be retried safely.
 * Returns 0 when no full sector is ready, or on failure. After stop, the last
 * partial sector is zero-padded and its exact native frame count is returned.
 * Call commit ONLY after the sector was successfully written to storage.
 * A COMPLETE take still needs adapter-side flush/verification before publish. */
uint32_t bonsai_record_peek_sector(struct bonsai_record *r, uint8_t out[512]);
bool bonsai_record_commit_sector(struct bonsai_record *r);
/* May be called by storage consumer on write/flush/verification failure.
 * FAILED is terminal until an exclusive start; it cannot become COMPLETE. */
void bonsai_record_fail(struct bonsai_record *r,
                        enum bonsai_record_error error);

#endif
```

## src/bonsai_stretch.h
```c
/* SPDX-License-Identifier: MIT */
#ifndef BONSAI_STRETCH_H
#define BONSAI_STRETCH_H
#include <stdbool.h>
#include <stdint.h>
#include <stdatomic.h>
#define BS_STEMS 4u
#define BS_SEQUENCE 1440u
#define BS_OVERLAP 384u
#define BS_SEARCH 600u
#define BS_HOP (BS_SEQUENCE-BS_OVERLAP)
#define BS_CACHE (BS_OVERLAP+2u*BS_SEARCH)
struct bs_frame { int16_t l,r; };
struct bs_plan {
 uint32_t chosen,nominal,fraction,ratio,next_nominal,next_fraction,generation;
 bool tail;
};
struct bs_state {
 struct bs_frame tail[BS_STEMS][BS_OVERLAP];
 struct bs_frame cached[BS_STEMS][2];
 uint32_t cached_cursor,cached_sequence;
 bool cached_valid;
 _Atomic uint32_t generation,requested,actual,sequence,cursor;
 _Atomic uint32_t chosen,nominal,fraction,next_nominal,next_fraction;
 _Atomic bool enabled,active,ready;
 bool active_tail;
 /* Storage-owned completed search; renderer cannot inspect pending until
  * ready. Parking releases shared scratch while the old overlap finishes. */
 bool prepared,prepared_transient;
 uint32_t prepared_sequence;
 struct bs_plan pending;
 uint32_t first;
};
/* One worker owns scratch; the audio thread never performs a search or writes
 * tail history. Search can run during the overlap; tail reuse waits for its
 * end. Completed searches park per deck without retaining this shared worker. */
struct bs_work {
 struct bs_frame cache[BS_CACHE];
 struct bs_frame reference[BS_OVERLAP];
 struct bs_state *owner;
 /* The packed reference folds channel balance into a shared-scale int16
  * coefficient. Exact integer moments track the quadratic energy window. */
 int64_t corr_dot,moment_a[2],moment_b[2],moment_e[2];
 float pack_scale;
 uint32_t reference_abs[2];
 struct bs_plan plan;
 uint32_t sequence,first,count,index,offset,limit,best,refine_end;
 float highest,reference_energy,reference_peak;
 float balance[2],reference_power[2];
 int8_t sign[2];
 uint8_t crossings[2];
 uint8_t stage,stride;
 uint32_t scan_count,onset,onset_last,onset_count,nonquiet_count;
 float scan_energy,scan_peak;
 bool transient;
};
typedef struct bs_frame (*bs_read_fn)(void *context,unsigned stem,uint32_t source);
/* Optional engine-owned bounded mixing. The caller has already validated the
 * published source span. Destination is worker-private; copy exactly count
 * frames using this call's immutable gain snapshot and the same /1024 rounding.
 * It may only read source state and write out; resets remain exclusive. */
typedef void (*bs_mix_batch_fn)(void *context,uint32_t source,uint32_t count,
                              const uint16_t gains[BS_STEMS],struct bs_frame *out);
/* Reset requires exclusive ownership against both service and renderer. */
void bs_init(struct bs_state *s,uint32_t first,bool enabled);
bool bs_request(struct bs_state *s,uint32_t ratio);
uint32_t bs_actual(const struct bs_state *s);
bool bs_cancel_stale(struct bs_work *work);
/* Worker only. Budget charges source channels copied, reference/energy
 * preparation and correlation channels compared. Every sample stage is
 * incremental, including reset. */
uint32_t bs_service(struct bs_state *s,struct bs_work *work,bs_read_fn read,
                    void *context,const uint16_t gains[BS_STEMS],uint32_t oldest,
                    uint32_t written,uint32_t budget);
uint32_t bs_service_with_batch(struct bs_state *s,struct bs_work *work,bs_read_fn read,
                    void *context,const uint16_t gains[BS_STEMS],uint32_t oldest,
                    uint32_t written,uint32_t budget,bs_mix_batch_fn batch);
/* Renderer only. Returns false until a complete plan is release-published. */
bool bs_activate(struct bs_state *s,uint32_t *nominal,uint32_t *fraction);
bool bs_buffered(struct bs_state *s,uint32_t oldest,uint32_t written);
/* Renderer-owned cached pairs: prepare once, then index every audible stem.
 * Valid until the next call after cursor advancement or descriptor activation. */
const struct bs_frame (*bs_samples(struct bs_state *s,bs_read_fn read,void *context))[2];
struct bs_frame bs_sample(struct bs_state *s,unsigned stem,unsigned which,
                          bs_read_fn read,void *context);
void bs_advance(struct bs_state *s);
uint32_t bs_retain(const struct bs_state *s);
#endif
```
