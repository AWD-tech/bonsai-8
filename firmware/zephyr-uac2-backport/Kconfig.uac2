## firmware/zephyr-uac2-backport/Kconfig.uac2
```kconfig
# Copyright (c) 2022 Nordic Semiconductor ASA
#
# SPDX-License-Identifier: Apache-2.0

config USBD_AUDIO2_CLASS
	bool "USB Audio 2 class support"
	select UDC_ENABLE_SOF
	help
	  USB Audio 2 device class support.

if USBD_AUDIO2_CLASS

config USBD_UAC2_FS_WINDOWS_WORKAROUND
	bool "Windows compatible Full-Speed explicit feedback (backport)"
	help
	  Microsoft Windows USB Audio 2.0 driver (usbaudio2.sys) expects the
	  Full-Speed explicit feedback endpoint wMaxPacketSize to be 4 (the
	  USB 2.0 specification says 3) and the value in Q16.16 format.
	  Without this, Windows shows the device with a warning (Code 10,
	  "cannot start"). Linux and macOS parse the format from the declared
	  size, so they work either way. Backported from upstream Zephyr
	  (see zephyrproject-rtos/zephyr issue #77212).

module = USBD_UAC2
module-str = usbd uac2
source "subsys/logging/Kconfig.template.log_config"

endif
```
